## r2t2/base-image/port/drivers-net-r2t2/Kconfig
```kconfig
config NET_R2T2
	tristate "R2T2 network fpga driver"
	depends on OF && HAS_DMA
	help
	  This option enables the R2T2 network driver for communication with fpga
```

## r2t2/base-image/port/image.its
```
/dts-v1/;
/ {
	description = "R2T2 arm uImage with single Linux kernel and FDT blob";
	#address-cells = <1>;
	images {
		kernel@1 {
			description = "R2T2 Kernel";
			data = /incbin/("zImage");
			type = "kernel";
			arch = "arm";
			os = "linux";
			compression = "none";
			load = <0x2008000>;
			entry = <0x2008000>;
			hash@1 { algo = "crc32"; };
		};
		fdt@1 {
			description = "Flattened Device Tree blob";
			data = /incbin/("zynq-r2t2.dtb");
			type = "flat_dt";
			arch = "arm";
			compression = "none";
			hash@1 { algo = "crc32"; };
		};
	};
	configurations {
		default = "conf@1";
		conf@1 {
			description = "R2T2 Boot Linux kernel with FDT blob";
			kernel = "kernel@1";
			fdt = "fdt@1";
		};
	};
};
```
